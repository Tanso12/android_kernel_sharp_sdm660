/* Copyright (c) 2016-2017, The Linux Foundation. All rights reserved.
 *
 * This program is free software; you can redistribute it and/or modify
 * it under the terms of the GNU General Public License version 2 and
 * only version 2 as published by the Free Software Foundation.
 *
 * This program is distributed in the hope that it will be useful,
 * but WITHOUT ANY WARRANTY; without even the implied warranty of
 * MERCHANTABILITY or FITNESS FOR A PARTICULAR PURPOSE.  See the
 * GNU General Public License for more details.
 */


/dts-v1/;

#include "sdm630.dtsi"
#include "sdm630-mtp.dtsi"
#include "sdm660-internal-codec.dtsi"
#include "fih/sd1/sd1-DVT-IDT.dtsi"
#include "fih/sd1/dsi-panel-ft8716-ffd-video-evt2-630.dtsi"

/ {
	model = "Qualcomm Technologies, Inc. SDM 630 PM660 + PM660L MTP, HH6 EVT !!!";
	compatible = "qcom,sdm630-mtp", "qcom,sdm630", "qcom,mtp";
	qcom,board-id = <8 0>;
	qcom,pmic-id = <0x0001001b 0x0101011a 0x0 0x0>,
			<0x0001001b 0x0201011a 0x0 0x0>;
	fih,hw-id = <10 0 1>;
};

